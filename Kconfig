## Kconfig
```kconfig
config CONDUCTOR_FIRMWARE_VERSION
    string "Conductor firmware version"
    default "0.4.1 beta"
```

## config/west.yml
```yaml
manifest:
  remotes:
    - name: zmkfirmware
      url-base: https://github.com/zmkfirmware
    - name: badjeff
      url-base: https://github.com/badjeff
    - name: pite1222
      url-base: https://github.com/pite1222
    - name: 4mplelab
      url-base: https://github.com/4mplelab
  projects:
    - name: zmk
      remote: pite1222
      revision: release/conductor-0.6.1
      import: app/west.yml
    # Override the zephyr pinned by zmk's manifest: same base
    # (zmkfirmware v4.1.0+zmk-fixes) plus the BLE controller prepare
    # pipeline fix for the multi-host LL_ASSERT reboot (lll.c:894).
    # Import settings mirror zmk/app/west.yml's zephyr entry.
    - name: zephyr
      remote: pite1222
      revision: release/conductor-0.6.0
      clone-depth: 1
      import:
        name-blocklist:
          - ci-tools
          - hal_altera
          - hal_cypress
          - hal_infineon
          - hal_microchip
          - hal_nxp
          - hal_openisa
          - hal_xtensa
          - hal_st
          - hal_ti
          - loramac-node
          - mcuboot
          - mcumgr
          - net-tools
          - openthread
          - edtt
          - trusted-firmware-m
    - name: zmk-studio-messages
      remote: pite1222
      revision: release/conductor-0.6.0
      path: modules/msgs/zmk-studio-messages
    - name: zmk-pmw3610-driver
      remote: badjeff
      revision: main
  self:
    path: config
```

## vendor/zmk-feature-charge-indicator/Kconfig
```kconfig
menu "Charge Indicator"

config CHARGE_INDICATOR
    bool "Enable charge status LED indicator"
    default n

config CHG_POLICY
    bool "Force off during charging (suppress widget)"
    default n
    help
      y: While charging, force LEDs OFF and suppress widget output.
      n: While charging, show selected color (CHG_COLOR) and suppress widget output.

config CHG_COLOR
    int "Charging color value (0-7)"
    range 0 7
    default 1
    help
      0 Black, 1 Red, 2 Green, 3 Yellow, 4 Blue, 5 Magenta, 6 Cyan, 7 White

config CHG_BATTERY_LEVEL_BASED_COLOR
    bool "Use battery level based color instead of fixed color"
    default y
    help
      y: LED color changes based on battery level while charging.
      n: Use fixed color (CONFIG_CHG_COLOR) while charging.

if CHG_BATTERY_LEVEL_BASED_COLOR

config CHG_BATTERY_LEVEL_HIGH
    int "High battery level percentage"
    default 80

config CHG_BATTERY_LEVEL_LOW
    int "Low battery level percentage"
    default 20

config CHG_BATTERY_LEVEL_CRITICAL
    int "Critical battery level percentage"
    default 5

config CHG_BATTERY_COLOR_HIGH
    int "Color for high battery level (above LEVEL_HIGH)"
    range 0 7
    default 2
    help
      0 Black, 1 Red, 2 Green, 3 Yellow, 4 Blue, 5 Magenta, 6 Cyan, 7 White

config CHG_BATTERY_COLOR_MEDIUM
    int "Color for medium battery level (between LEVEL_LOW and LEVEL_HIGH)"
    range 0 7
    default 3
    help
      0 Black, 1 Red, 2 Green, 3 Yellow, 4 Blue, 5 Magenta, 6 Cyan, 7 White

config CHG_BATTERY_COLOR_LOW
    int "Color for low battery level (below LEVEL_LOW)"
    range 0 7
    default 1
    help
      0 Black, 1 Red, 2 Green, 3 Yellow, 4 Blue, 5 Magenta, 6 Cyan, 7 White

config CHG_BATTERY_COLOR_CRITICAL
    int "Color for critical battery level (below LEVEL_CRITICAL)"
    range 0 7
    default 5
    help
      0 Black, 1 Red, 2 Green, 3 Yellow, 4 Blue, 5 Magenta, 6 Cyan, 7 White

config CHG_BATTERY_COLOR_MISSING
    int "Color for battery not detected"
    range 0 7
    default 0
    help
      0 Black, 1 Red, 2 Green, 3 Yellow, 4 Blue, 5 Magenta, 6 Cyan, 7 White

endif

config CHG_LOW_BATTERY_INDICATOR
    bool "Show solid color on low battery (when not charging)"
    default n
    help
      y: While NOT charging and battery level is at or below threshold,
         keep LEDs lit in a solid color and suppress widget output.
         Resumes widget when battery rises above threshold or charging
         starts (charging color takes priority).

if CHG_LOW_BATTERY_INDICATOR

config CHG_LOW_BATTERY_THRESHOLD
    int "Low battery percentage threshold"
    range 1 50
    default 10

config CHG_LOW_BATTERY_COLOR
    int "Color for low battery (0-7)"
    range 0 7
    default 1
    help
      0 Black, 1 Red, 2 Green, 3 Yellow, 4 Blue, 5 Magenta, 6 Cyan, 7 White

config CHG_CRITICAL_BATTERY_THRESHOLD
    int "Critical battery percentage threshold (blink mode)"
    range 0 50
    default 5
    help
      When battery <= this threshold (and not charging), the LED blinks
      using CHG_CRITICAL_BATTERY_COLOR. Should be <= CHG_LOW_BATTERY_THRESHOLD.
      Set to 0 to disable blinking (use solid low-battery color all the way down).

config CHG_CRITICAL_BATTERY_COLOR
    int "Color for critical battery blink (0-7)"
    range 0 7
    default 1
    help
      0 Black, 1 Red, 2 Green, 3 Yellow, 4 Blue, 5 Magenta, 6 Cyan, 7 White

config CHG_CRITICAL_BLINK_HALF_PERIOD_MS
    int "Critical blink half-period in ms (on/off duration each)"
    range 100 5000
    default 500

endif

endmenu
```
